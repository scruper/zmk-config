## config/west.yml
```yaml
manifest:
  remotes:
    - name: scruper
      url-base: https://github.com/scruper
    - name: zmkfirmware
      url-base: https://github.com/zmkfirmware
  projects:
    - name: zmk
      remote: zmkfirmware
      revision: main
      import: app/west.yml
  self:
    path: config
```
